## kernel-old/Kconfig
```kconfig
mainmenu "Nekonix (Nnix.)/x86_64 0.0.0-unknown Kernel Configuration"

#Build Type Options
choice
    prompt "Select Build Type"
    default BUILD_RELEASE

config BUILD_DEBUG
    bool "Debug"
    help
        Build the kernel with debugging enabled, providing extra logging
        and assertions for development purposes.

config BUILD_RELEASE
    bool "Release"
    help
        Build the kernel with optimizations and minimal logging for production use.

endchoice


choice
    prompt "Logging Options"
    default LOGGING_OPTION_GRAPHICAL

config LOGGING_OPTION_GRAPHICAL
    bool "Graphical Only"
    default n
    help
        Enable this option to display boot logs with graphical output.
        This provides a visually appealing output of kernel boot logs on
        supported hardware, enhancing debugging experience.


config LOGGING_OPTION_SERIAL
    bool "Serial Only"
    default n
    help
        Enable this option to display boot logs with serial output.
        This provides a visually appealing output of kernel boot logs on
        supported serial ports, enhancing debugging experience.

config LOGGING_OPTION_MIRROR
    bool "Mirrored"
    default n
    help
        Enable this option to mirror boot logs to both the framebuffer 
        and the serial console. This allows for better log accessibility
        on different output devices, such as serial terminals and screens.

config LOGGING_OPTION_ERROR_ONLY
    bool "Error Only, mirrored"
    default n
    help
        Enable this option to allow only error-level logs during boot and
        runtime. This ensures that the kernel outputs only critical error 
        information, ignoring less important logs such as warnings or 
        informational messages.

config LOGGING_OPTION_NO_LOGGING
    bool "Disable"
    default n
    help
        Enable this option to completely disable logging, including errors. 
        This is not recommended as it makes debugging issues more difficult. 
        Use this only for extreme use cases where logging overhead must be
        minimized entirely.

endchoice

config PMM_TEST_AMOUNT
    int "Amount of Physical Memory tests"
    default 10
    range 1 1000
    help
        Specify the number of PMM (Physical Memory Management) tests to run.
        This value must be between 1 and 1000. The default is 10.

        Adjust this setting based on the testing requirements and available
        system resources.

config VMM_TEST_AMOUNT
    int "Amount of Virtual Memory tests"
    default 10
    range 1 1000
    help
        Specify the number of VMM (Virtual Memory Management) tests to run.
        This value must be between 1 and 1000. The default is 10.

        Adjust this setting based on the testing requirements and available
        system resources.
```

## kernel/Kconfig
```kconfig
mainmenu "Nekonix (Nnix.)/x86_64 0.0.0-unknown Kernel Configuration"

choice
    prompt "Build Type"
    default BUILD_RELEASE

config BUILD_DEBUG
    bool "Debug"
    help
        Build the kernel with debugging enabled, providing extra logging
        and assertions for development purposes.

config BUILD_RELEASE
    bool "Release"
    help
        Build the kernel with optimizations and minimal logging for production use.

endchoice

config GRAPHICAL_BOOT_LOGS
    bool "Graphical Boot Logs"
    default y
    help
        Enable this option to display boot logs with graphical output.

config MIRROR_BOOT_LOGS
    bool "Mirror Boot Logs"
    default n
    depends on GRAPHICAL_BOOT_LOGS
    help
        Enable this option to mirror boot logs to the framebuffer as well as serial.
```
